## config/west.yml
```yaml
manifest:
  remotes:
    - name: zmkfirmware
      url-base: https://github.com/zmkfirmware

    - name: gpeye
      url-base: https://github.com/GPeye

    - name: Arawasu
      url-base: https://github.com/Arawasu

  projects:
    - name: zmk-sofle-eyelash-config
      url: https://github.com/apug/zmk-sofle-eyelash-config
      revision: main

    - name: hammerbeam-slideshow
      remote: Arawasu
      revision: main

    - name: zmk
      remote: zmkfirmware
      revision: main
      import: app/west.yml

    - name: zmk-nice-oled
      remote: Arawasu
      revision: main

  self:
    path: config
```
